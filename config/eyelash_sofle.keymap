#define ZMK_POINTING_DEFAULT_MOVE_VAL 1200  // 600
#define ZMK_POINTING_DEFAULT_SCRL_VAL 25   // 10

#include <input/processors.dtsi>
#include <zephyr/dt-bindings/input/input-event-codes.h>
#include <behaviors.dtsi>
#include <behaviors/num_word.dtsi>
#include <dt-bindings/zmk/bt.h>
#include <dt-bindings/zmk/keys.h>
#include <dt-bindings/zmk/outputs.h>
#include <dt-bindings/zmk/pointing.h>
#include <dt-bindings/zmk/rgb.h>

#include "zmk-helpers/helper.h"
#include "eyelash_sofle.h"                                    // Source key-labels.

#define QUICK_TAP_MS 175

#define DEF 0
#define QWERTY 1
#define NAV 2
#define FN 3
#define NUM 4
#define SYS 5
#define MOUSE 6

&sk {
  release-after-ms = <900>;
  quick-release;
};

&sl { // Allow sticky mods to chord across sticky layers.
  ignore-modifiers;
};

&lt {
  flavor = "balanced";
  tapping-term-ms = <200>;
  quick-tap-ms = <QUICK_TAP_MS>;
};

/* Homerow mods */

#define KEYS_L LT0 LT1 LT2 LT3 LT4 LT5 LM0 LM1 LM2 LM3 LM4 LM5 LB0 LB1 LB2 LB3 LB4 LB5 // Left-hand keys.
#define KEYS_R RT0 RT1 RT2 RT3 RT4 RT5 RM0 RM1 RM2 RM3 RM4 RM5 RB0 RB1 RB2 RB3 RB4 RB5 // Right-hand keys.
#define THUMBS LH3 LH2 LH1 LH0 RH0 RH1 RH2 RH3                                      // Thumb keys.

#define MAKE_HRM(NAME, HOLD, TAP, TRIGGER_POS)                                 \
  ZMK_HOLD_TAP(NAME, bindings = <HOLD>, <TAP>; flavor = "balanced";            \
               tapping-term-ms = <280>; quick-tap-ms = <QUICK_TAP_MS>;         \
               require-prior-idle-ms = <150>; hold-trigger-on-release;         \
               hold-trigger-key-positions = <TRIGGER_POS>;)

MAKE_HRM(hml, &kp, &kp, KEYS_R THUMBS) // Left-hand HRMs.
MAKE_HRM(hmr, &kp, &kp, KEYS_L THUMBS) // Right-hand HRMs.

// Hack: Make HRM combos tap-only (cf, ZMK issue #544).
#define ZMK_COMBO_8(NAME, TAP, POS, LAYERS, COMBO_MS, IDLE_MS, HOLD, SIDE)     \
  MAKE_HRM(hm_combo_##NAME, &kp, TAP, SIDE THUMBS)                             \
  ZMK_COMBO_6(NAME, &hm_combo_##NAME HOLD 0, POS, LAYERS, COMBO_MS, IDLE_MS)

/* Combos, leader key sequences, mouse emulation */

#include "combos.dtsi" // Must be sourced after HRM-combo hack.
#include "leader.dtsi"
#include "mouse.dtsi"

/* Nav cluster */

// Trigger tap-action on all interrupts.
#define MT_CORE                                                                \
  flavor = "tap-preferred";                                                    \
  tapping-term-ms = <220>;                                                     \
  quick-tap-ms = <220>;                                                        \
  hold-trigger-key-positions = <0>;

&mt { MT_CORE };

ZMK_HOLD_TAP(mt_home, bindings = <&masked_home>, <&kp>; MT_CORE)
ZMK_HOLD_TAP(mt_end, bindings = <&masked_end>, <&kp>; MT_CORE)

#define NAV_LEFT  &mt_home 0   LEFT  // Tap: left  | Long-tap: start of line.
#define NAV_RIGHT &mt_end 0    RIGHT // Tap: right | Long-tap: end   of line.
#define NAV_UP    &mt LC(HOME) UP    // Tap: up    | Long-tap: start of doc.
#define NAV_DOWN  &mt LC(END)  DOWN  // Tap: down  | Long-tap: end   of doc.
#define NAV_BSPC  &mt LC(BSPC) BSPC  // Tap: bspc  | Long-tap: delete word bwd.
#define NAV_DEL   &mt LC(DEL)  DEL   // Tap: del   | Long-tap: delete word fwd.

// Mask CTRL on left/right hold to avoid accidental jumps to start/end of doc.
#define MASK_MODS(NAME, MODS, BINDING)                                         \
  ZMK_MOD_MORPH(NAME, bindings = <BINDING>, <BINDING>; mods = <MODS>;)

MASK_MODS(masked_home, (MOD_LCTL), &kp HOME)
MASK_MODS(masked_end,  (MOD_LCTL), &kp END)


/* Magic-shift & auto-layers */

// Tap: repeat after alpha, else sticky-shift |
// Shift + tap/ double-tap: caps-word | Hold: shift.
#define MAGIC_SHIFT &magic_shift LSHFT 0
ZMK_HOLD_TAP(magic_shift, bindings = <&kp>, <&magic_shift_tap>;
             flavor = "balanced"; tapping-term-ms = <200>;
             quick-tap-ms = <QUICK_TAP_MS>;)
ZMK_MOD_MORPH(magic_shift_tap, bindings = <&shift_repeat>, <&caps_word>;
              mods = <(MOD_LSFT)>;)
ZMK_ADAPTIVE_KEY(
    shift_repeat, bindings = <&sk LSHFT>;
    repeat {
      trigger-keys = <A B C D E F G H I J K L M N O P Q R S T U V W X Y Z>;
      bindings = <&key_repeat>;
      max-prior-idle-ms = <1200>;
      strict-modifiers;
    };)
&caps_word { // Mods deactivate caps-word, requires PR #1451. [TODO: rebase]
  /delete-property/ ignore-modifiers;
};

// Tap: num-word | double-tap: sticky num-layer | Hold: num-layer.
#define SMART_NUM &smart_num NUM 0
ZMK_HOLD_TAP(smart_num, bindings = <&mo>, <&num_dance>; flavor = "balanced";
             tapping-term-ms = <200>; quick-tap-ms = <QUICK_TAP_MS>;)
ZMK_TAP_DANCE(num_dance, bindings = <&num_word NUM>, <&sl NUM>;
              tapping-term-ms = <200>;)

ZMK_HOLD_TAP(ltmux, bindings = <&mo>, <&tmux_prefix>; flavor = "balanced";
              tapping-term-ms = <200>; quick-tap-ms = <QUICK_TAP_MS>;)

// Smart-mouse, requires tri-state module.
ZMK_TRI_STATE(
    smart_mouse, bindings = <&tog MOUSE>, <&none>, <&tog MOUSE>;
    ignored-key-positions =
        <LT1 LT2 LH0 LH1 RT1 RT2 RT3 RM0 RM1 RM2 RM3 RM4 RB1 RB2 RB3 RH0 RH1>;
    ignored-layers = <MOUSE NAV FN>;)

/* Custom behaviors */

// Alt+Tab swapper, requires tri-state module.
ZMK_TRI_STATE(swapper, bindings = <&kt LALT>, <&kp TAB>, <&kt LALT>;
              ignored-key-positions = <LT2 RT2 RM1 RM2 RM3>;)

// Define mod-morph with a *single* mod trigger for less repetition.
#define SIMPLE_MORPH(NAME, MOD, BINDING1, BINDING2)                            \
  ZMK_MOD_MORPH(NAME, mods = <(MOD_L##MOD | MOD_R##MOD)>;                      \
                bindings = <BINDING1>, <BINDING2>;)

// Tap: comma | Shift + tap: semicolon | Ctrl + shift + tap: <.
SIMPLE_MORPH(comma_morph, SFT, &kp COMMA, &comma_inner_morph)
SIMPLE_MORPH(comma_inner_morph, CTL, &kp SEMICOLON, &kp LESS_THAN)

// Tap: dot | Shift + tap: colon | Ctrl + shift + tap: >.
SIMPLE_MORPH(dot_morph, SFT, &kp DOT, &dot_inner_morph)
SIMPLE_MORPH(dot_inner_morph, CTL, &kp COLON, &kp GREATER_THAN)

// Tap: qmark | Shift + tap: excl.
SIMPLE_MORPH(qexcl, SFT, &kp QMARK, &kp EXCL)

// Tap: space | Shift + tap: dot -> space -> sticky shift | Hold: nav layer.
// ZMK_HOLD_TAP(lt_spc, bindings = <&mo>, <&spc_morph>; flavor = "balanced";
//             tapping-term-ms = <200>; quick-tap-ms = <QUICK_TAP_MS>;)
// SIMPLE_MORPH(spc_morph, SFT, &kp SPACE, &dot_spc)
// ZMK_MACRO(dot_spc, bindings = <&kp DOT &kp SPACE &sk LSHFT>; wait-ms = <10>;
//          tap-ms = <10>;)

// Tap: left/right parenthesis | Shft + tap: less-than/greater-than.
SIMPLE_MORPH(lpar_lt, SFT, &kp LPAR, &kp LT)
SIMPLE_MORPH(rpar_gt, SFT, &kp RPAR, &kp GT)

// Sticky shift + leader.
ZMK_MACRO(leader_sft, bindings = <&sk LSHFT &leader>;)

// Misc aliases. [TODO: clean up]
#define CANCEL    &kp K_CANCEL            // Cancel caps-word & auto-layers.
#define DSK_PREV  &hmr LCTRL LG(LC(LEFT)) // Previous desktop.
#define DSK_NEXT  &hmr LALT LG(LC(RIGHT)) // Next     desktop.
#define PIN_WIN   &kp LG(LC(LS(Q)))       // Pin window across desktops.
#define PIN_APP   &kp LG(LC(LS(A)))       // Pin application across desktops.
#define DSK_MGR   &kp LA(GRAVE)           // Desktop manager.
#define VOL_DOWN  &hmr RSHFT C_VOL_DN

ZMK_CONDITIONAL_LAYER(sys, FN NUM, SYS)

// bebore code

&mmv_input_listener { input-processors = <&zip_xy_scaler 2 1>; };

&msc_input_listener { input-processors = <&zip_scroll_scaler 2 1>; };

&msc {
    acceleration-exponent = <1>;      // 0
    time-to-max-speed-ms = <100>;       // 300
    delay-ms = <0>;                   // 0
};

&mmv {
    time-to-max-speed-ms = <500>;
    acceleration-exponent = <1>;
    trigger-period-ms = <16>;
};

&soft_off { hold-time-ms = <2000>; };

/ {
    scroll_encoder: scroll_encoder {
        compatible = "zmk,behavior-sensor-rotate";
        #sensor-binding-cells = <0>;
        bindings = <&msc SCRL_DOWN>, <&msc SCRL_UP>;

        tap-ms = <100>;
    };

    behaviors {
    };

    macros {
        // os_only
        os_lang_only: os_lang_only {
            compatible = "zmk,behavior-macro";
            #binding-cells = <0>;
            bindings = 
                <&macro_press &kp LWIN>,
                <&macro_tap &kp SPACE>,
                <&macro_release &kp LWIN>;
        };
        
        // layer_and_os
        switch_both: switch_both {
            compatible = "zmk,behavior-macro";
            #binding-cells = <0>;
            bindings = 
                <&macro_press &tog 1 &kp LWIN>,
                <&macro_tap &kp SPACE>,
                <&macro_pause_for_release>,
                <&macro_release &tog 1 &kp LWIN>;
        };
        // layer_only
        switch_layer: switch_layer {
            compatible = "zmk,behavior-macro";
            #binding-cells = <0>;
            bindings = 
                <&macro_press &tog 1>,
                <&macro_pause_for_release>,
                <&macro_release &tog 1>;
        };

        /* --- NAVIGATION --- */
        tmux_up: tmux_up {
            compatible = "zmk,behavior-macro";
            #binding-cells = <0>;
            wait-ms = <10>; tap-ms = <10>;
            bindings = <&macro_press &kp LCTRL>, <&macro_tap &kp B>, <&macro_release &kp LCTRL>, <&macro_tap &kp UP>;
        };
        tmux_down: tmux_down {
            compatible = "zmk,behavior-macro";
            #binding-cells = <0>;
            wait-ms = <10>; tap-ms = <10>;
            bindings = <&macro_press &kp LCTRL>, <&macro_tap &kp B>, <&macro_release &kp LCTRL>, <&macro_tap &kp DOWN>;
        };
        tmux_left: tmux_left {
            compatible = "zmk,behavior-macro";
            #binding-cells = <0>;
            wait-ms = <10>; tap-ms = <10>;
            bindings = <&macro_press &kp LCTRL>, <&macro_tap &kp B>, <&macro_release &kp LCTRL>, <&macro_tap &kp LEFT>;
        };
        tmux_right: tmux_right {
            compatible = "zmk,behavior-macro";
            #binding-cells = <0>;
            wait-ms = <10>; tap-ms = <10>;
            bindings = <&macro_press &kp LCTRL>, <&macro_tap &kp B>, <&macro_release &kp LCTRL>, <&macro_tap &kp RIGHT>;
        };

        /* --- SPLITS & LAYOUT --- */
        tmux_h_split: tmux_h_split { // Horizontal Split (Prefix + ")
            compatible = "zmk,behavior-macro";
            #binding-cells = <0>;
            wait-ms = <10>; tap-ms = <10>;
            bindings = <&macro_press &kp LCTRL>, <&macro_tap &kp B>, <&macro_release &kp LCTRL>, <&macro_tap &kp DQT>;
        };
        tmux_v_split: tmux_v_split { // Vertical Split (Prefix + %)
            compatible = "zmk,behavior-macro";
            #binding-cells = <0>;
            wait-ms = <10>; tap-ms = <10>;
            bindings = <&macro_press &kp LCTRL>, <&macro_tap &kp B>, <&macro_release &kp LCTRL>, <&macro_tap &kp PRCNT>;
        };
        tmux_zoom: tmux_zoom { // Toggle Zoom (Prefix + z)
            compatible = "zmk,behavior-macro";
            #binding-cells = <0>;
            wait-ms = <10>; tap-ms = <10>;
            bindings = <&macro_press &kp LCTRL>, <&macro_tap &kp B>, <&macro_release &kp LCTRL>, <&macro_tap &kp Z>;
        };

        /* --- WINDOWS & SESSIONS --- */
        tmux_tree: tmux_tree { // Choose Tree/Session (Prefix + s)
            compatible = "zmk,behavior-macro";
            #binding-cells = <0>;
            wait-ms = <10>; tap-ms = <10>;
            bindings = <&macro_press &kp LCTRL>, <&macro_tap &kp B>, <&macro_release &kp LCTRL>, <&macro_tap &kp S>;
        };
        tmux_win_prev: tmux_win_prev { // Previous Window (Prefix + p)
            compatible = "zmk,behavior-macro";
            #binding-cells = <0>;
            wait-ms = <10>; tap-ms = <10>;
            bindings = <&macro_press &kp LCTRL>, <&macro_tap &kp B>, <&macro_release &kp LCTRL>, <&macro_tap &kp P>;
        };
        tmux_win_next: tmux_win_next { // Next Window (Prefix + n)
            compatible = "zmk,behavior-macro";
            #binding-cells = <0>;
            wait-ms = <10>; tap-ms = <10>;
            bindings = <&macro_press &kp LCTRL>, <&macro_tap &kp B>, <&macro_release &kp LCTRL>, <&macro_tap &kp N>;
        };

        /* --- UTILS --- */
        tmux_copy: tmux_copy { // Copy Mode (Prefix + [)
            compatible = "zmk,behavior-macro";
            #binding-cells = <0>;
            wait-ms = <10>; tap-ms = <10>;
            bindings = <&macro_press &kp LCTRL>, <&macro_tap &kp B>, <&macro_release &kp LCTRL>, <&macro_tap &kp LBKT>;
        };
        tmux_cmd: tmux_cmd { // Command Prompt (Prefix + :)
            compatible = "zmk,behavior-macro";
            #binding-cells = <0>;
            wait-ms = <10>; tap-ms = <10>;
            bindings = <&macro_press &kp LCTRL>, <&macro_tap &kp B>, <&macro_release &kp LCTRL>, <&macro_tap &kp COLON>;
        };
        tmux_swap: tmux_swap { // Swap Pane (Prefix + {)
            compatible = "zmk,behavior-macro";
            #binding-cells = <0>;
            wait-ms = <10>; tap-ms = <10>;
            bindings = <&macro_press &kp LCTRL>, <&macro_tap &kp B>, <&macro_release &kp LCTRL>, <&macro_tap &kp LBRC>;
        };
        tmux_kill: tmux_kill { // Kill Pane (Prefix + x)
            compatible = "zmk,behavior-macro";
            #binding-cells = <0>;
            wait-ms = <10>; tap-ms = <10>;
            bindings = <&macro_press &kp LCTRL>, <&macro_tap &kp B>, <&macro_release &kp LCTRL>, <&macro_tap &kp X>;
        };
        
        // Pure Prefix (just Ctrl+B)
        tmux_prefix: tmux_prefix {
            compatible = "zmk,behavior-macro";
            #binding-cells = <0>;
            wait-ms = <10>; tap-ms = <10>;
            bindings = <&macro_press &kp LCTRL>, <&macro_tap &kp B>, <&macro_release &kp LCTRL>;
        };
    };

    combos {
        compatible = "zmk,combos";

        softoff {
            bindings = <&soft_off>;
            key-positions = <14 28 40>;
        };
    };

    keymap {
        compatible = "zmk,keymap";

        layer_0 {
            bindings = <
&kp ESC         &kp N1         &kp N2           &kp N3            &kp N4          &kp N5       &kp UP_ARROW     &kp N6       &kp N7             &kp N8             &kp N9           &kp N0              &kp BACKSPACE
&kp TAB         &kp Q          &kp W            &kp F             &kp P           &kp B        &kp DOWN_ARROW   &kp J        &kp L              &kp U              &kp Y            &kp SQT             &kp BSLH
&switch_both    &hml LGUI A    &hml LALT R      &hml LSHFT S      &hml LCTRL T    &kp G        &kp LEFT_ARROW   &kp M        &hmr LCTRL N       &hmr RSHFT E       &hmr LALT I      &hmr LGUI O         &kp APOS
&kp LSHFT       &kp Z          &kp X            &kp C             &kp D           &kp V        &kp RIGHT_ARROW  &kp K        &kp H              &comma_morph       &dot_morph       &qexcl              &kp ENTER
&kp C_MUTE      &mo 9          &kp TAB          &kp ESC           &lt NAV SPACE   &lt FN TAB   &kp ENTER        SMART_NUM    MAGIC_SHIFT        &kp BACKSPACE      &kp DELETE       &mo 8
            >;

            sensor-bindings = <&inc_dec_kp C_VOLUME_UP C_VOL_DN>;
            display-name = "COLE";
        };

        layer_1 {
            bindings = <
&kp ESC         &kp N1         &kp N2           &kp N3            &kp N4            &kp N5       &kp UP_ARROW     &kp N6     &kp N7             &kp N8             &kp N9           &kp N0              &kp BACKSPACE
&kp TAB         &kp Q          &kp W            &kp E             &kp R             &kp T        &kp DOWN_ARROW   &kp Y      &kp U              &kp I              &kp O            &kp P               &kp LBKT
&switch_both    &hml LGUI A    &hml LALT S      &hml LSHFT D      &hml LCTRL F      &kp G        &kp LEFT_ARROW   &kp H      &hmr LCTRL J       &hmr RSHFT K       &hmr LALT L      &hmr LGUI SEMI      &kp SQT
&kp LSHFT       &kp Z          &kp X            &kp C             &kp V             &kp B        &kp RIGHT_ARROW  &kp N      &kp M              &kp COMMA          &kp DOT          &kp FSLH            &kp RBKT
&kp C_MUTE      &mo 9          &kp TAB          &kp ESC           &lt NAV SPACE     &lt FN TAB   &kp ENTER        SMART_NUM  MAGIC_SHIFT        &kp BACKSPACE      &kp DELETE       &mo 8
            >;

            sensor-bindings = <&inc_dec_kp C_VOLUME_UP C_VOL_DN>;
            display-name = "QWER";
        };

        layer_2 {
            bindings = <
&kp GRAVE       &kp F1            &kp F2          &kp F3           &kp F4           &kp F5           &mmv MOVE_UP     &kp F6           &kp F7           &kp F8          &kp F9       &kp F10           &trans
&os_lang_only   &kp LA(F4)        &kp ESC         &kp LS(TAB)      &swapper         &kp RET          &mmv MOVE_DOWN   &kp PG_UP        &kp HOME         &kp UP          &kp END      &kp HOME          &trans
&switch_both    &sk LGUI          &sk LALT        &sk LSHFT        &sk LCTRL        &ltmux 7 0       &mmv MOVE_LEFT   &kp PG_DN        &kp LEFT         &kp DOWN        &kp RIGHT    &kp DEL           &trans
&switch_layer   &trans            &trans          &trans           &trans           &trans           &mmv MOVE_RIGHT  &kp INS          &kp BACKSPACE    &comma_morph    &dot_morph   &kp END           &trans
&kp C_MUTE      &trans            &trans          &trans           &trans           &trans           &mkp LCLK        &kp RET          CANCEL           &trans          &trans       &trans
            >;

            display-name = "NAV";
            sensor-bindings = <&scroll_encoder>;
        };

        layer_3 {
            bindings = <
&trans          &trans            &trans          &trans           &trans           &trans           &mmv MOVE_UP     &trans           &trans           &trans         &trans        &trans          &trans
&trans          &kp F12           &kp F7          &kp F8           &kp F9           &trans           &mmv MOVE_DOWN   &kp PG_UP        &kp C_PREV       &kp C_VOL_UP   &kp C_NEXT    &trans          &trans
&trans          &hml LGUI F11     &hml LALT F4    &hml LSHFT F5    &hml LCTRL F6    &trans           &mmv MOVE_LEFT   &kp PG_DN        DSK_PREV         VOL_DOWN       DSK_NEXT      &trans          &trans
&trans          &kp F10           &kp F1          &kp F2           &kp F3           &trans           &mmv MOVE_RIGHT  PIN_APP          PIN_WIN          DSK_MGR        &trans        &trans          &trans
&trans          &trans            &trans          &trans           &trans           &trans           &mkp LCLK        &kp C_MUTE       &kp C_PP         &trans         &trans        &trans
            >;

            display-name = "FN";
            sensor-bindings = <&scroll_encoder>;
        };

        layer_4 {
            bindings = <
&trans          &trans            &trans          &trans           &trans           &trans           &mmv MOVE_UP     &trans        &trans           &trans         &trans        &trans            &trans
&trans          &trans            &kp N7          &kp N8           &kp N9           &trans           &mmv MOVE_DOWN   &trans        &trans           &trans         &trans        &trans            &trans
&trans          &hml LGUI N0      &hml LALT N4    &hml LSHFT N5    &hml LCTRL N6    &trans           &mmv MOVE_LEFT   &trans        &trans           &trans         &trans        &trans            &trans
&trans          &trans            &kp N1          &kp N2           &kp N3           &trans           &mmv MOVE_RIGHT  &trans        &trans           &trans         &trans        &trans            &trans
&trans          &trans            &trans          &trans           &trans           &trans           &mkp LCLK        &trans        &trans           &trans         &trans        &trans
            >;

            display-name = "NUM";
            sensor-bindings = <&scroll_encoder>;
        };

        layer_5 {
            bindings = <
&trans          &trans            &trans          &trans           &trans           &trans           &mmv MOVE_UP       &trans           &trans           &trans      &trans     &trans            &trans
&trans          &bt BT_SEL 0      &bt BT_SEL 1    &bt BT_SEL 3     &bt BT_CLR       &trans           &mmv MOVE_DOWN     &trans           &trans           &trans      &trans     &trans            &trans
&trans          &trans            &trans          &trans           &trans           &bootloader      &mmv MOVE_LEFT     &bootloader      &trans           &trans      &trans     &trans            &trans
&trans          &trans            &trans          &trans           &trans           &sys_reset       &mmv MOVE_RIGHT    &sys_reset       &trans           &trans      &trans     &trans            &trans
&trans          &trans            &trans          &trans           &trans           &trans           &mkp LCLK          &trans           &trans           &trans      &trans     &trans
            >;

            display-name = "SYS";
            sensor-bindings = <&scroll_encoder>;
        };

        layer_6 {
            bindings = <
&trans          &trans            &trans          &trans           &trans           &trans           &mmv MOVE_UP       &trans           &trans           &trans      &trans       &trans          &trans
&trans          &trans            &trans          &trans           &trans           &trans           &mmv MOVE_DOWN     &trans           &kp PG_UP        U_MS_U      &kp PG_DN    &trans          &trans
&trans          &trans            &trans          &trans           &trans           &trans           &mmv MOVE_LEFT     U_WH_L           U_MS_L           U_MS_D      U_MS_R       U_WH_R          &trans
&trans          &trans            &trans          &trans           &trans           &trans           &mmv MOVE_RIGHT    &trans           &mkp LCLK        &mkp MCLK   &mkp RCLK    &trans          &trans
&trans          &trans            &trans          &trans           &trans           &trans           &mkp LCLK          U_WH_U           U_WH_D           &trans      &trans       &trans
            >;

            display-name = "MOUSE";
            sensor-bindings = <&scroll_encoder>;
        };

        layer_7 {
            bindings = <
&trans          &trans            &trans          &trans           &trans           &trans           &mmv MOVE_UP       &trans           &trans           &trans          &trans          &trans            &trans
&trans          &trans            &trans          &trans           &trans           &trans           &mmv MOVE_DOWN     &tmux_v_split    &tmux_zoom       &tmux_up        &tmux_copy      &tmux_h_split     &trans
&trans          &trans            &trans          &trans           &trans           &trans           &mmv MOVE_LEFT     &tmux_prefix     &tmux_left       &tmux_down      &tmux_right     &tmux_tree        &trans
&trans          &trans            &trans          &trans           &trans           &trans           &mmv MOVE_RIGHT    &tmux_cmd        &tmux_win_prev   &tmux_swap      &tmux_win_next  &tmux_kill        &trans
&trans          &trans            &trans          &trans           &trans           &trans           &mkp LCLK          &trans           &trans           &trans          &trans          &trans
            >;

            display-name = "Tmux";
            sensor-bindings = <&scroll_encoder>;
        };

        layer_8 {
            bindings = <
&kp TILDE  &bt BT_SEL 0  &bt BT_SEL 1    &bt BT_SEL 2  &bt BT_SEL 3  &bt BT_SEL 4    &mmv MOVE_UP     &kp F6  &kp F7  &kp F8      &kp F9     &kp F10      &trans
&trans     &bt BT_CLR    &bt BT_CLR_ALL  &trans        &trans        &trans          &mmv MOVE_DOWN   &trans  &trans  &kp F11     &kp F12    &kp UNDER    &kp PLUS
&trans     &out OUT_USB  &out OUT_BLE    &trans        &trans        &trans          &mmv MOVE_LEFT   &trans  &trans  &trans      &trans     &kp LBRC     &kp RBRC
&trans     &sys_reset    &trans          &bootloader   &trans        &trans          &mmv MOVE_RIGHT  &trans  &trans  &sys_reset  &soft_off  &bootloader  &trans
&trans     &trans        &trans          &trans        &trans        &trans          &mkp LCLK        &trans  &trans  &trans      &trans     &trans
            >;

            display-name = "sf1";
            sensor-bindings = <&scroll_encoder>;
        };

        layer_9 {
            bindings = <
&kp GRAVE       &kp F1           &kp F2          &kp F3           &kp F4           &kp F5             &mmv MOVE_UP     &kp F6           &kp F7           &kp F8      &kp F9     &kp F10           &trans
&os_lang_only   &kp GRAVE        &mkp LCLK       &mkp MCLK        &mkp RCLK        &mkp MB4           &mmv MOVE_DOWN   &kp PG_UP        &kp END          &kp UP      &kp HOME   &kp MINUS         &kp EQUAL
&switch_both    &kp TILDE        &trans          &trans           &trans           &mkp MB5           &mmv MOVE_LEFT   &kp PG_DN        &kp LEFT         &kp DOWN    &kp RIGHT  &kp LEFT_BRACKET  &kp RIGHT_BRACKET
&switch_layer   &rgb_ug RGB_OFF  &rgb_ug RGB_ON  &rgb_ug RGB_EFF  &rgb_ug RGB_EFR  &rgb_ug RGB_SPI    &mmv MOVE_RIGHT  &rgb_ug RGB_BRI  &rgb_ug RGB_BRD  &kp INSERT  &kp F11    &kp F12           &trans
&kp C_MUTE      &trans           &trans          &trans           &trans           &trans             &mkp LCLK        &trans           &trans           &trans      &trans     &trans
            >;

            display-name = "sf2";
            sensor-bindings = <&scroll_encoder>;
        };
    };
};
